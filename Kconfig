## lib/Kconfig
```kconfig
# SPDX-FileCopyrightText: 2025 Anna-Lena Marx <mail@marx.engineer>
#
# SPDX-License-Identifier: MPL-2.0

menu "Libraries"

#rsource "ui/Kconfig"
#rsource "epub/Kconfig"

endmenu
```

## lib/epub/Kconfig
```kconfig
config EPUB
    bool "Support for ZEReader ePub lib"
    help
        This option enables the ePub lib
```

## west.yml
```yaml
# SPDX-FileCopyrightText: 2025 Anna-Lena Marx <mail@marx.engineer>
#
# SPDX-License-Identifier: MPL-2.0

manifest:
  version: "1.0"
  defaults:
    remote: zephyrproject
    revision: main

  remotes:
    - name: zephyrproject
      url-base: https://github.com/zephyrproject-rtos


  projects:
    - name: zephyr
      path: zephyr-rtos
      remote: zephyrproject

      import:
        name-allowlist:
          - cmsis_6
          - fatfs
          - hal_rpi_pico
          - lvgl

  self:
    west-commands: scripts/west-commands.yml
```
